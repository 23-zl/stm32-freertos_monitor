#include "oled.h"
#include <string.h>
#include "main.h"

static I2C_HandleTypeDef *oled_i2c;
static uint8_t OLED_Buffer[128 * 8];
extern UART_HandleTypeDef huart1;

/* 6x8 ASCII字库，从空格(0x20)到波浪线(0x7E) */
static const uint8_t Font6x8[][6] = {
    {0x00,0x00,0x00,0x00,0x00,0x00}, // space
    {0x00,0x00,0x5F,0x00,0x00,0x00}, // !
    {0x00,0x00,0x07,0x00,0x07,0x00}, // "
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    {0x00,0x02,0x01,0x02,0x04,0x02}, // ~
};

static void OLED_WriteCmd(uint8_t cmd)
{
    HAL_I2C_Mem_Write(oled_i2c, 0x78, 0x00, I2C_MEMADD_SIZE_8BIT, &cmd, 1, 100);
}

static void OLED_WriteData(uint8_t data)
{
    HAL_I2C_Mem_Write(oled_i2c, 0x78, 0x40, I2C_MEMADD_SIZE_8BIT, &data, 1, 100);
}

void OLED_Init(I2C_HandleTypeDef *hi2c)
{
    oled_i2c = hi2c;
	  
    HAL_Delay(200);

    uint8_t init_cmds[] = {
        0xAE, 0x20, 0x00, 0xB0, 0xC8, 0x00, 0x10, 0x40,
        0x81, 0xFF, 0xA1, 0xA6, 0xA8, 0x3F, 0xA4, 0xD3,
        0x00, 0xD5, 0xF0, 0xD9, 0x22, 0xDA, 0x12, 0xDB,
        0x20, 0x8D, 0x14, 0xAF
    };

    for(uint8_t i = 0; i < sizeof(init_cmds); i++)
    {
        OLED_WriteCmd(init_cmds[i]);
        HAL_Delay(1);
    }
    HAL_Delay(100);
    
    OLED_Clear();
    OLED_Refresh();
}

void OLED_Clear(void)
{
    memset(OLED_Buffer, 0, sizeof(OLED_Buffer));
}

void OLED_Refresh(void)
{
    for(uint8_t page = 0; page < 8; page++)
    {
        OLED_WriteCmd(0xB0 + page);
        OLED_WriteCmd(0x00);
        OLED_WriteCmd(0x10);
        for(uint8_t col = 0; col < 128; col++)
        {
            OLED_WriteData(OLED_Buffer[page * 128 + col]);
        }
    }
}

void OLED_ShowChar(uint8_t x, uint8_t y, char ch, uint8_t size)
{
    if (x + 6 > 128 || y + 8 > 64) return;
    if (ch < ' ' || ch > '~') ch = ' '; // 无效字符显示为空格
    
    uint8_t index = ch - ' ';
    for (uint8_t i = 0; i < 6; i++)
    {
        uint8_t line = Font6x8[index][i];
        for (uint8_t j = 0; j < 8; j++)
        {
            if (line & (1 << j))
            {
                OLED_Buffer[x + i + (y/8 + j/8)*128] |= (1 << (j%8));
            }
        }
    }
}

void OLED_ShowString(uint8_t x, uint8_t y, char *str, uint8_t size)
{
    while (*str)
    {
        OLED_ShowChar(x, y, *str, size);
        x += 6;
        if (x > 122) { x = 0; y += 8; }
        str++;
    }
}

